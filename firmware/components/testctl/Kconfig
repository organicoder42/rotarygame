## firmware/components/testctl/Kconfig
```kconfig
menu "Knob test control"

config KNOB_TESTCTL
    bool "Serial test console on USB Serial/JTAG (inject knob/tap, dump screen)"
    default y
    help
        A line-oriented console on the USB Serial/JTAG port for automated verification:
        `knob +3`, `tap`, `zone`, `hold`, `reset`, `state`, `snap`. Replies start with "> ".
        `snap` streams the LVGL framebuffer as base64 rows prefixed "S:" (host:
        scripts/testctl.py). It shares the port with the Ekko protocol (PROTOCOL.md): the
        protocol commands `hello`, `hud`, `hap` work with or without this option. Disable for
        production images.

endmenu
```
